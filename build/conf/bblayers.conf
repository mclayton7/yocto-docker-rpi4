## build/conf/bblayers.conf
```bitbake
# POKY_BBLAYERS_CONF_VERSION is increased each time build/conf/bblayers.conf
# changes incompatibly
POKY_BBLAYERS_CONF_VERSION = "2"

BBPATH = "${TOPDIR}"
BBFILES ?= ""

BBLAYERS ?= " \
  /home/server/yocto-docker-rpi4/layers/poky/meta \
  /home/server/yocto-docker-rpi4/layers/poky/meta-poky \
  /home/server/yocto-docker-rpi4/layers/poky/meta-yocto-bsp \
  /home/server/yocto-docker-rpi4/layers/meta-openembedded/meta-oe \
  /home/server/yocto-docker-rpi4/layers/meta-openembedded/meta-filesystems \
  /home/server/yocto-docker-rpi4/layers/meta-openembedded/meta-multimedia \
  /home/server/yocto-docker-rpi4/layers/meta-openembedded/meta-networking \
  /home/server/yocto-docker-rpi4/layers/meta-openembedded/meta-python \
  /home/server/yocto-docker-rpi4/layers/meta-raspberrypi \
  /home/server/yocto-docker-rpi4/layers/meta-virtualization \
  "
```
